## config/boards/shields/brain/Kconfig.defconfig
```kconfig
# Copyright (c) 2022 Duccio Breschi
# Copyright (c) 2023 iamDrakkir
# SPDX-License-Identifier: MIT

if SHIELD_BRAIN_LEFT

config ZMK_KEYBOARD_NAME
    default "Brain"

config ZMK_SPLIT_ROLE_CENTRAL
    default y

endif

if SHIELD_BRAIN_LEFT || SHIELD_BRAIN_RIGHT
config ZMK_SPLIT
    default y
endif
```

## config/boards/shields/brain/Kconfig.shield
```kconfig
# Copyright (c) 2022 Duccio Breschi
# Copyright (c) 2023 iamDrakkir
# SPDX-License-Identifier: MIT

config SHIELD_BRAIN_LEFT
    def_bool $(shields_list_contains,brain_left)

config SHIELD_BRAIN_RIGHT
    def_bool $(shields_list_contains,brain_right)
```
